## scripts/template.its
```
/*
 * ==========================================================================
 * Copyright (c) Qualcomm Technologies, Inc. and/or its subsidiaries.
 * SPDX-License-Identifier: ISC
 * ==========================================================================
 */

/dts-v1/;

/* Component availability defines */
#define HAVE_FDT 0
#define HAVE_DPR 0
#define HAVE_QCLIB_V7 0
#define HAVE_QCCONFIG_V7 0
#define HAVE_TFA_BL31_V7 0
#define HAVE_UBOOT_V7 0
#define HAVE_OPTEE_V7 0

/ {
    description = "FIT Image for Vendor Boot Loader";

    images {

#if HAVE_DPR == 1
        dpr {
            description = "dpr";
            data = /incbin/("./DPR_FILENAME");
            type = "firmware";
            arch = "arm64";
            os = "elf";
            load = <DPR_LOAD_ADDR>;
            compression = "none";
        };
#endif

        qcconfig_1 {
            description = "qcconfig1";
            data = /incbin/("./qcconfig_1_load_segment.bin");
            type = "firmware";
            arch = "arm64";
            os = "elf";
            load = <QCCONFIG_1_LOAD_ADDR>;
            entry = <QCCONFIG_ENTRY_ADDR>;
            compression = "none";
        };

        qcconfig_2 {
            description = "qcconfig2";
            data = /incbin/("./qcconfig_2_load_segment.bin");
            type = "firmware";
            arch = "arm64";
            load = <QCCONFIG_2_LOAD_ADDR>;
            compression = "none";
        };

        qcconfig_3 {
            description = "qcconfig3";
            data = /incbin/("./qcconfig_3_load_segment.bin");
            type = "firmware";
            arch = "arm64";
            load = <QCCONFIG_3_LOAD_ADDR>;
            compression = "none";
        };

        qcconfig_4 {
            description = "qcconfig4";
            data = /incbin/("./qcconfig_4_load_segment.bin");
            type = "firmware";
            arch = "arm64";
            load = <QCCONFIG_4_LOAD_ADDR>;
            compression = "none";
        };

        qcconfig-meta {
            description = "qcconfig meta";
            data = /incbin/("./qcconfig_meta_segments.bin");
            type = "firmware";
            arch = "arm64";
            load = <META_LOAD_ADDR>;
            entry = <QCCONFIG_ENTRY_ADDR>;
            compression = "none";
        };

#if HAVE_QCCONFIG_V7 == 1
        qcconfig-meta-v7 {
            description = "qcconfig meta v7";
            data = /incbin/("./qcconfig_v7_meta_segments.bin");
            type = "firmware";
            arch = "arm64";
            load = <META_LOAD_ADDR>;
            entry = <QCCONFIG_V7_ENTRY_ADDR>;
            compression = "none";
        };
#endif

        qclib_1 {
            description = "qclib1";
            data = /incbin/("./qclib_1_load_segment.bin");
            type = "firmware";
            arch = "arm64";
            os = "elf";
            load = <QCLIB_1_LOAD_ADDR>;
            entry = <QCLIB_ENTRY_ADDR>;
            compression = "none";
        };

        qclib_2 {
            description = "qclib2";
            data = /incbin/("./qclib_2_load_segment.bin");
            type = "firmware";
            arch = "arm64";
            load = <QCLIB_2_LOAD_ADDR>;
            compression = "none";
        };

        qclib-meta {
            description = "qclib meta";
            data = /incbin/("./qclib_meta_segments.bin");
            type = "firmware";
            arch = "arm64";
            load = <META_LOAD_ADDR>;
            entry = <QCLIB_ENTRY_ADDR>;
            compression = "none";
        };

#if HAVE_QCLIB_V7 == 1
        qclib-meta-v7 {
            description = "qclib meta v7";
            data = /incbin/("./qclib_v7_meta_segments.bin");
            type = "firmware";
            arch = "arm64";
            load = <META_LOAD_ADDR>;
            entry = <QCLIB_V7_ENTRY_ADDR>;
            compression = "none";
        };
#endif

        tfa_bl31_1 {
            description = "tfa_bl311";
            data = /incbin/("./tfa_bl31_1_load_segment.bin");
            type = "firmware";
            arch = "arm64";
            os = "arm-trusted-firmware";
            load = <TFA_BL31_1_LOAD_ADDR>;
            entry = <TFA_BL31_ENTRY_ADDR>;
            compression = "none";
        };

        tfa_bl31_2 {
            description = "tfa_bl312";
            data = /incbin/("./tfa_bl31_2_load_segment.bin");
            type = "firmware";
            arch = "arm64";
            load = <TFA_BL31_2_LOAD_ADDR>;
            compression = "none";
        };

        tfa_bl31_3 {
            description = "tfa_bl313";
            data = /incbin/("./tfa_bl31_3_load_segment.bin");
            type = "firmware";
            arch = "arm64";
            load = <TFA_BL31_3_LOAD_ADDR>;
            compression = "none";
        };

        tfa_bl31_4 {
            description = "tfa_bl314";
            data = /incbin/("./tfa_bl31_4_load_segment.bin");
            type = "firmware";
            arch = "arm64";
            os = "arm-trusted-firmware";
            load = <TFA_BL31_4_LOAD_ADDR>;
            entry = <TFA_BL31_ENTRY_ADDR>;
            compression = "none";
        };

        tfa_bl31-meta {
            description = "tfa_bl31 meta";
            data = /incbin/("./tfa_bl31_meta_segments.bin");
            type = "firmware";
            arch = "arm64";
            load = <META_LOAD_ADDR>;
            entry = <TFA_BL31_ENTRY_ADDR>;
            compression = "none";
        };

#if HAVE_TFA_BL31_V7 == 1
        tfa_bl31-meta-v7 {
            description = "tfa_bl31 meta v7";
            data = /incbin/("./tfa_bl31_v7_meta_segments.bin");
            type = "firmware";
            arch = "arm64";
            load = <META_LOAD_ADDR>;
            entry = <TFA_BL31_V7_ENTRY_ADDR>;
            compression = "none";
        };
#endif

        uboot_1 {
            description = "uboot1";
            data = /incbin/("./uboot_1_load_segment.bin");
            type = "standalone";
            arch = "UBOOT_ARCH";
            os = "u-boot";
            load = <UBOOT_1_LOAD_ADDR>;
            entry = <UBOOT_ENTRY_ADDR>;
            compression = "none";
        };

        uboot-meta {
            description = "uboot meta";
            data = /incbin/("./uboot_meta_segments.bin");
            type = "standalone";
            arch = "UBOOT_ARCH";
            load = <META_LOAD_ADDR>;
            entry = <UBOOT_ENTRY_ADDR>;
            compression = "none";
        };

#if HAVE_UBOOT_V7 == 1
        uboot-meta-v7 {
            description = "uboot meta v7";
            data = /incbin/("./uboot_v7_meta_segments.bin");
            type = "standalone";
            arch = "UBOOT_ARCH";
            load = <META_LOAD_ADDR>;
            entry = <UBOOT_V7_ENTRY_ADDR>;
            compression = "none";
        };
#endif

        optee_1 {
            description = "optee1";
            data = /incbin/("./optee_1_load_segment.bin");
            type = "firmware";
            arch = "arm64";
            os = "tee";
            load = <OPTEE_1_LOAD_ADDR>;
            entry = <OPTEE_ENTRY_ADDR>;
            compression = "none";
        };

        optee-meta {
            description = "optee meta";
            data = /incbin/("./optee_meta_segments.bin");
            type = "firmware";
            arch = "arm64";
            load = <META_LOAD_ADDR>;
            entry = <OPTEE_ENTRY_ADDR>;
            compression = "none";
        };

#if HAVE_OPTEE_V7 == 1
        optee-meta-v7 {
            description = "optee meta v7";
            data = /incbin/("./optee_v7_meta_segments.bin");
            type = "firmware";
            arch = "arm64";
            load = <META_LOAD_ADDR>;
            entry = <OPTEE_V7_ENTRY_ADDR>;
            compression = "none";
        };
#endif

#if HAVE_FDT == 1
        fdt-uboot {
            description = "ARM64 OpenWrt qcom_maxx device tree blob";
            data = /incbin/("./FDT_PATH");
            type = "flat_dt";
            arch = "arm64";
            compression = "none";
        };
#endif

    };

 configurations {
                default = "post-ddr-config";
#if HAVE_QCCONFIG_V7 == 1
#if HAVE_QCLIB_V7 == 1
                pre-ddr-config-v7 {
                        description = "pre-ddr-v7";
                        loadables =
                        "qcconfig_1", "qcconfig_2", "qcconfig_3", "qcconfig_4", "qcconfig-meta-v7",
                        "qclib_1", "qclib_2", "qclib-meta-v7"
                        ;
                };
#endif
#endif
#if HAVE_TFA_BL31_V7 == 1
#if HAVE_UBOOT_V7 == 1
#if HAVE_OPTEE_V7 == 1
                post-ddr-config-v7 {
                        description = "post-ddr-v7";
                        loadables =
                        "tfa_bl31_1", "tfa_bl31_2", "tfa_bl31_3", "tfa_bl31_4", "tfa_bl31-meta-v7",
                        "uboot_1", "uboot-meta-v7",
                        "optee_1", "optee-meta-v7"
                        ;
                };
#endif
#endif
#endif
                pre-ddr-config {
                        description = "pre-ddr";
                        loadables =
#if HAVE_DPR == 1
                        "dpr",
#endif
                        "qcconfig_1", "qcconfig_2", "qcconfig_3", "qcconfig_4", "qcconfig-meta",
                        "qclib_1", "qclib_2", "qclib-meta"
                        ;
                };
                post-ddr-config {
                        description = "post-ddr";
                        loadables =
                        "tfa_bl31_1", "tfa_bl31_2", "tfa_bl31_3", "tfa_bl31_4", "tfa_bl31-meta",
                        "uboot_1", "uboot-meta",
                        "optee_1", "optee-meta"
                        ;
#if HAVE_FDT == 1
                        fdt = "fdt-uboot";
#endif
                };
        };
};
```
